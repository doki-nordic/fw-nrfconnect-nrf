## prj.conf
```kconfig
#
# Copyright (c) 2024 Nordic Semiconductor ASA
#
# SPDX-License-Identifier: LicenseRef-Nordic-5-Clause
#
################################################################################
# Application configuration

CONFIG_CAF=y

CONFIG_CAF_INIT_LOG_SENSOR_EVENTS=n

CONFIG_CAF_SENSOR_MANAGER=y

CONFIG_APP_EVENT_MANAGER=y
CONFIG_EVENT_MANAGER_PROXY=y
CONFIG_HEAP_MEM_POOL_SIZE=4096
CONFIG_REBOOT=y

CONFIG_SENSOR=y

CONFIG_IPC_SERVICE=y
CONFIG_MBOX=y

################################################################################
# Debug configuration

CONFIG_ASSERT=y
CONFIG_RESET_ON_FATAL_ERROR=n

CONFIG_LOG=y
CONFIG_GPIO=y

#CONFIG_ML_APP_EI_DATA_FORWARDER=n
#CONFIG_ML_APP_EI_DATA_FORWARDER_EVENTS=n

#CONFIG_PM=y
#CONFIG_PM_S2RAM=y
#CONFIG_PM_S2RAM_CUSTOM_MARKING=y
```

## boards/nrf54h20dk_nrf54h20_cpuppr.conf
```kconfig
#
# Copyright (c) 2024 Nordic Semiconductor ASA
#
# SPDX-License-Identifier: LicenseRef-Nordic-5-Clause
#
################################################################################
# Application configuration

CONFIG_ML_APP_SENSOR_EVENT_DESCR="accel_xyz"

CONFIG_ML_APP_EVENT_PROXY=y
CONFIG_ML_APP_REMOTE_CORE_INITIALIZATION_TIMEOUT=10000

CONFIG_SIZE_OPTIMIZATIONS=y

################################################################################
# System configuration

CONFIG_TIMESLICING=n

# LIBC minimal configuration
CONFIG_MINIMAL_LIBC=y
CONFIG_MINIMAL_LIBC_TIME=n
CONFIG_COMMON_LIBC_MALLOC=n
CONFIG_MINIMAL_LIBC_NON_REENTRANT_FUNCTIONS=n

CONFIG_HEAP_MEM_POOL_SIZE=512
CONFIG_EVENT_MANAGER_PROXY=y
# Higher timouts are required.
CONFIG_EVENT_MANAGER_PROXY_BIND_TIMEOUT_MS=4000

CONFIG_GPIO=y

################################################################################
# Debug configuration
CONFIG_LOG=n
CONFIG_LOG_MODE_MINIMAL=y

CONFIG_ASSERT=n
CONFIG_ASSERT_VERBOSE=n
CONFIG_BOOT_BANNER=n
CONFIG_NCS_BOOT_BANNER=n

CONFIG_DEBUG=n
CONFIG_PRINTK=y

CONFIG_MAIN_STACK_SIZE=1024
CONFIG_IDLE_STACK_SIZE=128
CONFIG_ISR_STACK_SIZE=1024

# Interrupts
CONFIG_DYNAMIC_INTERRUPTS=n
CONFIG_IRQ_OFFLOAD=n

# Memory protection
CONFIG_HW_STACK_PROTECTION=n
CONFIG_THREAD_STACK_INFO=n
CONFIG_THREAD_CUSTOM_DATA=n
CONFIG_FPU=n

# ADXXL362 sensor configuration
CONFIG_ADXL362=y
CONFIG_ADXL362_ACCEL_RANGE_8G=y
CONFIG_ADXL362_ACCEL_ODR_100=y
CONFIG_ADXL362_TRIGGER_GLOBAL_THREAD=y
CONFIG_ADXL362_INACTIVITY_THRESHOLD=0
CONFIG_ADXL362_ACTIVITY_THRESHOLD=110
CONFIG_ADXL362_ABS_REF_MODE=1

CONFIG_CONSOLE=n
CONFIG_SERIAL=n
CONFIG_UART_CONSOLE=n
```

## src/main.c
```c
/*
 * Copyright (c) 2024 Nordic Semiconductor ASA
 *
 * SPDX-License-Identifier: LicenseRef-Nordic-5-Clause
 */

#include <zephyr/kernel.h>
#include <app_event_manager.h>

#define MODULE main
#include <caf/events/module_state_event.h>

#include <zephyr/logging/log.h>
LOG_MODULE_REGISTER(MODULE);

int main(void)
{
	LOG_INF("Machine learning: %s started", CONFIG_BOARD_TARGET);

	while (1) k_sleep(K_MSEC(10000));

	if (app_event_manager_init()) {
		LOG_ERR("Application Event Manager initialization failed");
		__ASSERT_NO_MSG(false);
	} else {
		module_set_state(MODULE_STATE_READY);
	}
	return 0;
}
```
