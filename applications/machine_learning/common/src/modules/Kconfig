## applications/machine_learning/common/src/modules/Kconfig
```kconfig
#
# Copyright (c) 2023 Nordic Semiconductor ASA
#
# SPDX-License-Identifier: LicenseRef-Nordic-5-Clause
#

menu "Common modules"

rsource "Kconfig.event_proxy"
rsource "Kconfig.sensor_stub_gen"

config APP_SENSOR_SLEEP_TO
	int "Sensor default time in seconds before sensor goes to sleep"
	default 10
	help
	  The number of seconds of inactivity before sensor goes into sleep mode.
	  This configuration is used only for physical sensors that have triggers configured.
	  It is ignored for simulated sensors.

endmenu
```
